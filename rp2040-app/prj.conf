## prj.conf
```kconfig
CONFIG_HEAP_MEM_POOL_SIZE=65536

CONFIG_GPIO=y
CONFIG_PWM=y

CONFIG_STDOUT_CONSOLE=y
CONFIG_PRINTK=y
CONFIG_LOG=y
CONFIG_LOG_PRINTK=y
CONFIG_LOG_MODE_IMMEDIATE=y
CONFIG_PWM_LOG_LEVEL_DBG=y
CONFIG_ADC=y

CONFIG_CPP=y
CONFIG_COMMON_LIBC_MALLOC_ARENA_SIZE=4098

CONFIG_CBPRINTF_FP_SUPPORT=y

# Enable all for production firmware
CONFIG_FORCE_PACK=y
CONFIG_CLOCK_CONTROL=y
```

## src/main.cpp
```c
#include <zephyr/kernel.h>
#include <zephyr/drivers/gpio.h>
#include <zephyr/device.h>
#include <zephyr/drivers/pwm.h>
#include <zephyr/drivers/uart.h>
#include <string.h>
#include <stdio.h>

#include "hw_errors.h"
#include "pid.h"
#include "adc.h"
#include "battery.h"

extern "C" {
#include <msg.h>
}

#define PERIOD    PWM_NSEC(2500) // 500Khz
#define STACKSIZE 32768

#define MSG_SIZE 32
K_MSGQ_DEFINE(uart_msgq, MSG_SIZE, 10, 4);

static const struct pwm_dt_spec pwm = PWM_DT_SPEC_GET(DT_ALIAS(pwm_0));

static const struct gpio_dt_spec pwm_en =
	GPIO_DT_SPEC_GET(DT_ALIAS(pwm_en), gpios);

static const struct gpio_dt_spec pwm_skip =
	GPIO_DT_SPEC_GET(DT_ALIAS(pwm_skip), gpios);

static const struct gpio_dt_spec vin_detect =
	GPIO_DT_SPEC_GET(DT_ALIAS(vin_detect), gpios);

static const struct gpio_dt_spec pack_boot =
	GPIO_DT_SPEC_GET(DT_ALIAS(pack_boot), gpios);

static const struct gpio_dt_spec gpio2 =
	GPIO_DT_SPEC_GET(DT_ALIAS(gpio_2), gpios);

static const struct gpio_dt_spec gpio3 =
	GPIO_DT_SPEC_GET(DT_ALIAS(gpio_3), gpios);

static const struct device *const uart_dev =
	DEVICE_DT_GET(DT_CHOSEN(zephyr_mcu_uart));

void print_voltages(Adc adc, float drive)
{
	printk("Vout : %d mV\t", adc.get_vout());
	printk("Vbat : %d mV\t", adc.get_vbat());
	printk("Iout : %d mA\t", adc.get_iout());
	printk("Ibat : %d mA\t", adc.get_ibat());
	printk("Drve : %f\n", drive);
}

/* receive buffer used in UART ISR callback */
static char rx_buf[MSG_SIZE];
static int rx_buf_pos;

struct k_msgq msgq;
char msgq_buffer[sizeof(struct Msg) * 2];

/*
 * Read characters from UART until line end is detected. Afterwards push the
 * data to the message queue.
 */
void serial_cb(const struct device *dev, void *user_data)
{
	uint8_t c;

	if (!uart_irq_update(uart_dev)) {
		return;
	}

	if (!uart_irq_rx_ready(uart_dev)) {
		return;
	}

	while (uart_fifo_read(uart_dev, &c, 1) == 1) {
		if (!c && rx_buf_pos > sizeof(struct Msg)) {
			// We have a complete packet
			struct Msg msg = {};
			msg_cobs_decode(rx_buf, &msg);
			while (k_msgq_put(&msgq, &msg, K_NO_WAIT) != 0) {
				k_msgq_purge(&msgq);
			}
			rx_buf_pos = 0;
		} else if (c) {
			rx_buf[rx_buf_pos++] = c;
		}
	}
}

void print_uart(char *buf, uint8_t msg_len)
{
	for (int i = 0; i < msg_len; i++) {
		uart_poll_out(uart_dev, buf[i]);
	}
}

enum State {
	NONE,
	BUCK,
	BOOST,
	ERROR
} state;

void buckboost(void)
{
	int ret = 0;
	float drive = 0.8;
	float vout = 0;
	char uartbuf[64] = {};
	bool powered = false;
	uint8_t errors = 0;
	int countdown = 0;
	Msg msg_out = {.vout = 0, .vbat = 0};
	Msg msg_in = {0};

	k_msgq_init(&msgq, msgq_buffer, sizeof(struct Msg), 2);
	printk("~~~ Protectli UPS ~~~\n");

	HwErrors hw_errors;
	Pid buck_pid(12.0, 0.03, 0.0001, 0.0);

	Battery battery = Battery().set_voltage(16.8).set_current(1000.0);

	gpio_pin_configure_dt(&pwm_en, GPIO_OUTPUT_INACTIVE);
	gpio_pin_configure_dt(&pack_boot, GPIO_OUTPUT);
	gpio_pin_configure_dt(&pwm_skip, GPIO_OUTPUT_ACTIVE);
	gpio_pin_configure_dt(&vin_detect, GPIO_INPUT);

	gpio_pin_configure_dt(&gpio2, GPIO_DISCONNECTED);
	gpio_pin_configure_dt(&gpio3, GPIO_DISCONNECTED);

	k_sleep(K_MSEC(1000));

	Adc adc;
	adc.sample_all();

	if (!device_is_ready(pwm.dev)) {
		printk("Error: PWM device %s is not ready\n", pwm.dev->name);
	}

	if (!device_is_ready(uart_dev)) {
		printk("UART device not found!");
	}

	/* configure interrupt and callback to receive data */
	uart_irq_callback_user_data_set(uart_dev, serial_cb, NULL);
	uart_irq_rx_enable(uart_dev);

	state = NONE;
	while (true) {
		adc.sample_all();
		powered = gpio_pin_get_dt(&vin_detect);
		errors = hw_errors.check();

		if (!countdown--) {
			countdown = 1000;
			print_voltages(adc, drive);

			msg_out.vout = adc.get_vout();
			msg_out.vbat = adc.get_vbat();
			msg_out.iout = adc.get_iout();
			msg_out.ibat = adc.get_ibat();
			if (adc.get_vbat() < 12000) {
				msg_out.gas = 0;
			} else {
				msg_out.gas = (adc.get_vbat() - 12000) / 48;
			}

			ret = msg_cobs_encode(msg_out, uartbuf);
			print_uart(uartbuf, ret);

			ret = k_msgq_get(&msgq, &msg_in, K_MSEC(10));
			if (ret != 0) {
				if (msg_in.power_dwn && !powered) {
					printk("Power Down Requested @ \n");
					msg_in.power_dwn = false;
				}
			}
		}

		// Buck State
		if (!errors && !powered) {
			if (state != BUCK) {
				state = BUCK;
				printk("Entering Buck State\n");
				k_sleep(K_MSEC(5U));
				msg_out.state = MSG_STATE_DISCHARGING;
			}
			vout = adc.get_vout();
			vout = vout / 1000;
			buck_pid.compute(vout);
			drive = buck_pid.get_duc();

			gpio_pin_set_dt(&pwm_en, true);
			pwm_set_dt(&pwm, PERIOD, PERIOD * drive);
		}

		// Boost State (Charging)
		else if (!errors && powered) {
			if (state != BOOST) {
				drive = 1.0;
				state = BOOST;
				printk("Entering Boost State\n");
				k_sleep(K_MSEC(5U));
				msg_out.state = MSG_STATE_CHARGING;
#if defined(CONFIG_FORCE_PACK)
				gpio_pin_set_dt(&pack_boot, true);
				k_sleep(K_MSEC(100U));
				gpio_pin_set_dt(&pack_boot, false);
#endif
			}

			// Reduce charge current near the end of CC
			// cycle.
			if (adc.get_vbat() > 16500) {
				battery.set_scaling(0.3);
			} else if (adc.get_vbat() > 16600) {
				battery.set_scaling(0.1);
			} else {
				battery.set_scaling(1);
			}

			drive = battery.compute_drive(adc.get_vbat(),
						      adc.get_ibat(), drive);

			pwm_set_dt(&pwm, PERIOD, PERIOD * drive);
			gpio_pin_set_dt(&pwm_en, true);
		}
		// Error State
		else {
			if (state != ERROR) {
				state = ERROR;
				msg_out.state = MSG_STATE_ERROR;
				printk("Entering Error State\n");
			}
			gpio_pin_set_dt(&pwm_en, false);
			hw_errors.clear();
			state = NONE;
		}
	}
}

K_THREAD_DEFINE(buckboost_id, STACKSIZE, buckboost, NULL, NULL, NULL, 0, 0, 0);
```

## src/adc.cpp
```c
#include "adc.h"

#if !DT_NODE_EXISTS(DT_PATH(zephyr_user)) ||                                   \
	!DT_NODE_HAS_PROP(DT_PATH(zephyr_user), io_channels)
#error "No suitable devicetree overlay specified"
#endif

#define DT_SPEC_AND_COMMA(node_id, prop, idx)                                  \
	ADC_DT_SPEC_GET_BY_IDX(node_id, idx),

static uint16_t buf;

/* Data of ADC io-channels specified in devicetree. */
static const struct adc_dt_spec adc_channels[] = {DT_FOREACH_PROP_ELEM(
	DT_PATH(zephyr_user), io_channels, DT_SPEC_AND_COMMA)};

Adc::Adc()
	: num_chan(ARRAY_SIZE(adc_channels)), vout(0), vbat(0), iout(0), ibat(0)
{
	int err;

	sequence = {
		.buffer = &buf,
		/* buffer size in bytes, not number of samples */
		.buffer_size = sizeof(buf),
	};

	/* Configure channels individually prior to sampling. */
	for (size_t i = 0U; i < ARRAY_SIZE(adc_channels); i++) {
		if (!device_is_ready(adc_channels[i].dev)) {
			printk("ADC controller device %s not ready\n",
			       adc_channels[i].dev->name);
		}

		err = adc_channel_setup_dt(&adc_channels[i]);
		if (err < 0) {
			printk("Could not setup channel #%d (%d)\n", i, err);
		}
	}
}

bool Adc::check_chan(size_t ch)
{
	if (ch > num_chan) {
		printk("Channel out of range!");
		return false;
	}
	return true;
}

int Adc::read(size_t i)
{
	int err;
	int32_t val_mv;

	if (!check_chan(i)) {
		return -1;
	}

	(void)adc_sequence_init_dt(&adc_channels[i], &sequence);
	err = adc_read(adc_channels[i].dev, &sequence);

	if (err < 0) {
		printk("Could not read (%d)\n", err);
		return -1;
	}

	if (adc_channels[i].channel_cfg.differential) {
		val_mv = (int32_t)((int16_t)buf);
	} else {
		val_mv = (int32_t)buf;
	}

	err = adc_raw_to_millivolts_dt(&adc_channels[i], &val_mv);

	return val_mv;
}

int Adc::sample_vout()
{
	// (R4 + R6) / R6
	// (1e6 + 240e3) / 240e3 = 5.1666
	vout = read(0) * 5.1666;
	return vout;
}

int Adc::sample_vbat()
{
	// (R7 + R8) / R8
	// (100e3 + 7.32e3) / 7.32e3 = 14.6612
	vbat = read(1) * 14.6612;
	return vbat;
}

int Adc::sample_iout()
{
	// I = ((V / R5) / U5_Gain)
	iout = (read(2) / 5e-3) / 20;
	return iout;
}

int Adc::sample_ibat()
{
	// I = ((V / R2) / U21_Gain)
	ibat = (read(3) / 5e-3) / 200;
	return ibat;
}

void Adc::sample_all()
{
	sample_vout();
	sample_vbat();
	sample_iout();
	sample_ibat();
}
```

## src/adc.h
```c
#include <zephyr/drivers/adc.h>

class Adc
{
	uint8_t num_chan;
	struct adc_sequence sequence;
	int vout, vbat, iout, ibat;

	bool check_chan(size_t ch);
	int read(size_t chan);

      public:
	Adc();

	int sample_vout();
	int sample_vbat();
	int sample_iout();
	int sample_ibat();

	void sample_all();
	int get_vout()
	{
		return vout;
	};
	int get_vbat()
	{
		return vbat;
	};
	int get_iout()
	{
		return iout;
	};
	int get_ibat()
	{
		return ibat;
	};
};
```

## src/battery.cpp
```c
#include <string.h>
#include <stdlib.h>
#include "battery.h"
#include "csd97395.h"

Battery::Battery()
	: bump_amt(0.000001), initial_drive(0.780), _drive(initial_drive),
	  scaling(1)
{
}

float Battery::compute_drive(float v, float i)
{

	if (i < target_i && v < target_v) {
		_drive -= bump_amt; // This adds current
	} else {
		_drive += bump_amt;
	}

	if (_drive >= MAX_DRIVE) {
		_drive = MAX_DRIVE;
	}

	// If the drive have dipped below this amount, something has happened.
	if (_drive <= MIN_DRIVE) {
		_drive = initial_drive;
	}

	return _drive;
}

#define I_TSH 100
#define V_TSH 0.2

float Battery::compute_drive(float v, float i, float drive)
{
	float tg_i = target_i * scaling;

	if ((abs(i - tg_i) < I_TSH) || abs(v - target_v) < V_TSH) {
		// Do nothing
	} else if (i < tg_i && v < target_v) {
		drive -= bump_amt; // This adds current
	} else {
		drive += bump_amt;
	}

	if (drive >= MAX_DRIVE) {
		drive = MAX_DRIVE;
	}

	// If the drive have dipped below this amount, something has happened.
	if (drive <= MIN_DRIVE) {
		drive = initial_drive;
	}

	return drive;
}
```

## src/battery.h
```c
#include <zephyr/kernel.h>

class Battery
{
	int target_v; // mV
	float bump_amt;
	float initial_drive;
	float _drive;
	float target_i; // mA
	float scaling;

      public:
	Battery();
	float compute_drive(float v, float i);
	float compute_drive(float v, float i, float drive);

	Battery &set_voltage(float v)
	{
		target_v = v * 1000;
		return *this;
	}

	Battery &set_current(float i)
	{
		target_i = i;
		return *this;
	}

	Battery &set_scaling(float s)
	{
		scaling = s;
		return *this;
	}
};
```

## src/csd97395.h
```c
#pragma once

#define MAX_DRIVE 0.95
#define MIN_DRIVE 0.65
```

## src/hw_errors.cpp
```c
#include <string.h>
#include <zephyr/kernel.h>
#include <zephyr/drivers/gpio.h>
#include "hw_errors.h"

/* LEDs */
static const struct gpio_dt_spec load_oc_led =
	GPIO_DT_SPEC_GET(DT_ALIAS(load_overcurrent_led), gpios);

static const struct gpio_dt_spec batt_oc_led =
	GPIO_DT_SPEC_GET(DT_ALIAS(batt_overcurrent_led), gpios);

static const struct gpio_dt_spec batt_ov_led =
	GPIO_DT_SPEC_GET(DT_ALIAS(batt_overvoltage_led), gpios);

/* Input Signals from HW */
static const struct gpio_dt_spec load_oc =
	GPIO_DT_SPEC_GET(DT_NODELABEL(load_overcurrent), gpios);

static const struct gpio_dt_spec batt_oc =
	GPIO_DT_SPEC_GET(DT_NODELABEL(batt_overcurrent), gpios);

static const struct gpio_dt_spec batt_ov =
	GPIO_DT_SPEC_GET(DT_NODELABEL(batt_overvoltage), gpios);

HwErrors::HwErrors()
	: error_code(0), error_count(100), cur_error_count(0), rst_ctr(1000)
{
	gpio_pin_configure_dt(&load_oc_led, GPIO_OUTPUT_INACTIVE);
	gpio_pin_configure_dt(&batt_oc_led, GPIO_OUTPUT_INACTIVE);
	gpio_pin_configure_dt(&batt_ov_led, GPIO_OUTPUT_INACTIVE);

	gpio_pin_configure_dt(&load_oc, GPIO_INPUT);
	gpio_pin_configure_dt(&batt_oc, GPIO_INPUT);
	gpio_pin_configure_dt(&batt_ov, GPIO_INPUT);
}

uint8_t HwErrors::check(void)
{
	// Every 1000 calls, if there is no errors zero the error counter
	// we're looking for errors happening in a row
	if (!rst_ctr-- && !error_code) {
		cur_error_count = 0x00;
		rst_ctr = 1000;
	}

	/* Load Overcurrent */
	if (gpio_pin_get_dt(&load_oc)) {
		cur_error_count++;
		gpio_pin_set_dt(&load_oc_led, true);
		if (cur_error_count > error_count) {
			printk("Load Overcurrent! \n");
			error_code |= (1 << Errors::LOAD_OC);
		}
	} else {
		gpio_pin_set_dt(&load_oc_led, false);
	}

	/* Battery Overcurrent */
	if (gpio_pin_get_dt(&batt_oc)) {
		cur_error_count++;
		gpio_pin_set_dt(&batt_oc_led, true);
		if (cur_error_count > error_count) {
			printk("Battery Overcurrent! \n");
			error_code |= (1 << Errors::BATT_OC);
		}
	} else {
		gpio_pin_set_dt(&batt_oc_led, false);
	}

	/* Battery Overvoltage */
	if (gpio_pin_get_dt(&batt_ov)) {
		cur_error_count++;
		gpio_pin_set_dt(&batt_ov_led, true);
		if (cur_error_count > error_count) {
			printk("Battery Overvoltage! \n");
			error_code |= (1 << Errors::BATT_OV);
		}
	} else {
		gpio_pin_set_dt(&batt_ov_led, false);
	}

	return error_code;
}

void HwErrors::clear(void)
{
	error_code = 0x00;
	cur_error_count = 0x00;
}
```

## src/hw_errors.h
```c
class HwErrors
{
	enum Errors {
		LOAD_OC,
		BATT_OC,
		BATT_OV
	};

	uint8_t error_code;
	uint16_t error_count;     // How many errors until you flag it
	uint16_t cur_error_count; // Current amount of flagged errors
	uint16_t rst_ctr;

      public:
	HwErrors();
	uint8_t check();
	void clear();
};
```

## src/pid.cpp
```c
#include <zephyr/kernel.h>
#include "pid.h"
#include "csd97395.h"

Pid::Pid(float target, float kp, float ki, float kd)
	: target(target), kp(kp), ki(ki), kd(kd), e_sum(0)
{
	compute(target);
}

float Pid::get_i_term(void)
{
	return e_sum;
}

void Pid::zero_i_term(void)
{
	e_sum = 0;
}

float Pid::compute(float actual)
{
	uint32_t t = k_cycle_get_32();
	float e = target - actual;
	float dt = (t - t_prev) / 125e6;
	float de = e - e_prev;
	float derivatave = (e - e_prev) / dt;
	e_sum += e;

	if (e_sum < INTEGRATOR_WINDUP_NEG) {
		e_sum = INTEGRATOR_WINDUP_NEG;
	}

	drive = (e * kp) + (e_sum * ki) + (derivatave * kd);

	if (drive >= MAX_DRIVE) {
		drive = MAX_DRIVE;
	}

	if (drive <= 0.02) {
		drive = 0.02;
	}

	e_prev = e;
	t_prev = t;
	return drive;
}
```

## src/pid.h
```c
#define INTEGRATOR_WINDUP_NEG (-100)
#define INTEGRATOR_WINDUP_POS (1000000)

class Pid
{
	float target;
	float kp, ki, kd;
	float e_prev, e_sum;
	float t, t_prev;
	float drive;

      protected:
	void update_target();

      public:
	Pid(float target, float kp, float ki, float kd);
	float compute(float actual);
	float compute_boost(float actual);
	float get_i_term(void);
	void zero_i_term(void);

	void update_target(float t)
	{
		target = t;
	}

	float get_duc()
	{
		return drive;
	}
};
```
